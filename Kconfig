## Kconfig
```kconfig
config CHARYBDIS_ADV_WATCHDOG
	bool "Restart split peripheral advertising when ZMK fails to"
	default y
	depends on ZMK_SPLIT_BLE && !ZMK_SPLIT_ROLE_CENTRAL
	help
	  ZMK v0.3 restarts advertising from the disconnected() callback, before
	  Zephyr has released the connection object. With one connection slot the
	  start can fail with -ENOMEM, and ZMK only logs it — the half then stays
	  dark until it is reset. This keeps retrying while disconnected.

config CHARYBDIS_ADV_WATCHDOG_INTERVAL_MS
	int "Retry interval while disconnected"
	default 3000
	depends on CHARYBDIS_ADV_WATCHDOG

config CHARYBDIS_MOUSE_RELEASE
	bool "Resend the mouse button state after endpoint changes and reconnects"
	default y
	depends on ZMK_POINTING
	depends on !ZMK_SPLIT || ZMK_SPLIT_ROLE_CENTRAL
	help
	  ZMK v0.3 clears mouse buttons on an endpoint switch without telling the
	  host, and sends nothing on BLE reconnect. A button held at that moment
	  stays pressed on the host (no hover, that button stops working for every
	  pointing device). This sends the current button state to USB and BLE
	  after each endpoint change and active-profile (re)connect.

rsource "drivers/pmw3610/Kconfig"
```
